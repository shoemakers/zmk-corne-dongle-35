## config/west.yml
```yaml
manifest:
  remotes:
    - name: zmkfirmware
      url-base: https://github.com/zmkfirmware
    - name: gpeye
      url-base: https://github.com/GPeye
    - name: tokyo2006
      url-base: https://github.com/tokyo2006
    - name: englmaxi
      url-base: https://github.com/englmaxi
    - name: urob
      url-base: https://github.com/urob

  projects:
    - name: hammerbeam-slideshow
      remote: gpeye
      revision: main 
    - name: zmk
      remote: zmkfirmware
      revision: v0.3.0
      import: app/west.yml

    # Add ZMK modules from configuration 1
    - name: zmk-adaptive-key
      remote: urob
      revision: v0.3 # set to same as ZMK version above
    - name: zmk-auto-layer
      remote: urob
      revision: v0.3 # set to same as ZMK version above
    - name: zmk-leader-key
      remote: urob
      revision: v0.3 # set to same as ZMK version above
    - name: zmk-tri-state
      remote: urob
      revision: v0.3 # set to same as ZMK version above
    - name: zmk-unicode
      remote: urob
      revision: v0.3 # set to same as ZMK version above
      

    - name: prospector-zmk-module
      remote: tokyo2006
      revision: change_spi2
    - name: zmk-dongle-display
      remote: englmaxi
      revision: main

  self:
    path: config
```
